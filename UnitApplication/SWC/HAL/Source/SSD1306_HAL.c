#include "SSD1306_HAL.h"
#include "hardware/i2c.h"
#include <string.h>

SSD1306_t display;

// I2C Address for SSD1306 (adjust if necessary)
#define SSD1306_I2C_ADDR 0x3C

// Font data (5x7 font for characters ' ' to 'Z' and '0' to '9')
static const uint8_t font_5x7[][5] = {
    {0x00, 0x00, 0x00, 0x00, 0x00}, // 32: Space
    {0x00, 0x00, 0x5F, 0x00, 0x00}, // 33: !
    {0x00, 0x07, 0x00, 0x07, 0x00}, // 34: "
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    {0x10, 0x08, 0x08, 0x10, 0x08}, // 126: ~
};


// SSD1306 initialization commands
static const uint8_t ssd1306_init_commands[] = {
    0xAE, // Display off
    0xD5, 0x80, // Set display clock divide ratio
    0xA8, SSD1306_HEIGHT - 1, // Set multiplex
    0xD3, 0x00, // Set display offset
    0x40, // Set display start line to 0
    0x8D, 0x14, // Enable charge pump
    0x20, 0x00, // Set memory addressing mode to horizontal
    0xA1, // Set segment re-map
    0xC8, // Set COM output scan direction
    0xDA, 0x12, // Set COM pins hardware configuration
    0x81, 0x7F, // Set contrast control
    0xD9, 0xF1, // Set pre-charge period
    0xDB, 0x40, // Set VCOMH deselect level
    0xA4, // Enable display output GDDRAM
    0xA6, // Set normal display mode (A7 for inverse)
    0xAF // Display on
};

static void ssd1306_send_command(uint8_t command) {
    uint8_t buffer[2] = {0x00, command};
    i2c_write_blocking(i2c_default, SSD1306_I2C_ADDR, buffer, 2, false);
}

void ssd1306_init(SSD1306_t* display, i2c_inst_t* i2c) {
    i2c_init(i2c, 400 * 1000);  // Initialize I2C at 400kHz
    gpio_set_function(I2C_SDA_PIN, GPIO_FUNC_I2C);
    gpio_set_function(I2C_SCL_PIN, GPIO_FUNC_I2C);
    gpio_pull_up(I2C_SDA_PIN);
    gpio_pull_up(I2C_SCL_PIN);

    display->i2c = i2c;
    memset(display->buffer, 0, sizeof(display->buffer));
    for (uint8_t i = 0; i < sizeof(ssd1306_init_commands); i++) {
        ssd1306_send_command(ssd1306_init_commands[i]);
    }
    ssd1306_clear(display);
    ssd1306_update_display(display);
}

void ssd1306_update_display(SSD1306_t* display) {
    ssd1306_send_command(0x21); // Column address
    ssd1306_send_command(0);    // Start column
    ssd1306_send_command(SSD1306_WIDTH - 1); // End column
    ssd1306_send_command(0x22); // Page address
    ssd1306_send_command(0);    // Start page
    ssd1306_send_command((SSD1306_HEIGHT / 8) - 1); // End page

    uint8_t buffer[SSD1306_WIDTH + 1];
    buffer[0] = 0x40;
    for (uint8_t page = 0; page < SSD1306_HEIGHT / 8; page++) {
        for (uint8_t col = 0; col < SSD1306_WIDTH; col++) {
            buffer[col + 1] = display->buffer[page * SSD1306_WIDTH + col];
        }
        i2c_write_blocking(i2c_default, SSD1306_I2C_ADDR, buffer, SSD1306_WIDTH + 1, false);
    }
}

void ssd1306_clear(SSD1306_t* display) {
    for (int i = 0; i < sizeof(display->buffer); i++) {
        display->buffer[i] = 0x00;
    }
}

// Draw a single pixel
void ssd1306_draw_pixel(SSD1306_t* display, uint8_t x, uint8_t y, bool on) {
    if (x >= SSD1306_WIDTH || y >= SSD1306_HEIGHT) return;
    uint16_t byte_idx = x + (y / 8) * SSD1306_WIDTH;
    uint8_t bit_mask = 1 << (y % 8);
    if (on) {
        display->buffer[byte_idx] |= bit_mask;
    } else {
        display->buffer[byte_idx] &= ~bit_mask;
    }
}

// Draw a character at specified position
void ssd1306_draw_char(SSD1306_t* display, uint8_t x, uint8_t y, char c) {
    if (c < 32 || c > 126) return;
    const uint8_t* char_data = font_5x7[c - 32];
    for (uint8_t col = 0; col < 5; col++) {
        uint8_t pixels = char_data[col];
        for (uint8_t row = 0; row < 7; row++) {
            bool on = pixels & (1 << row);
            ssd1306_draw_pixel(display, x + col, y + row, on);
        }
    }
}

// Draw a string at specified position
void ssd1306_draw_string(SSD1306_t* display, uint8_t x, uint8_t y, const char* str) {
    while (*str) {
        ssd1306_draw_char(display, x, y, *str++);
        x += 6;  // Move to the right for the next character (5-pixel width + 1 pixel spacing)
    }
}